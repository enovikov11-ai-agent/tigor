## infra/0-box/learnings/custom-kernel/my_defconfig
```kconfig
BR2_LINUX_KERNEL=y
BR2_LINUX_KERNEL_CUSTOM_CMDLINE="amd_iommu=on iommu=pt console=ttyS0,115200 console=tty0 root=/dev/ram0 rw"
BR2_LINUX_KERNEL_CUSTOM_CMDLINE_OVERRIDE=y
BR2_LINUX_KERNEL_CUSTOM_CONFIG_FILE="board/pc/linux.config"
BR2_LINUX_KERNEL_CUSTOM_VERSION=y
BR2_LINUX_KERNEL_CUSTOM_VERSION_VALUE="6.1.24"
BR2_LINUX_KERNEL_INSTALL_TARGET=y
BR2_LINUX_KERNEL_NEEDS_HOST_LIBELF=y
BR2_LINUX_KERNEL_NEEDS_HOST_OPENSSL=y
BR2_LINUX_KERNEL_USE_CUSTOM_CONFIG=y
BR2_PACKAGE_ACPID=y
BR2_PACKAGE_BASH=y
BR2_PACKAGE_BIND=y
BR2_PACKAGE_BTRFS_PROGS=y
BR2_PACKAGE_BUSYBOX=y
BR2_PACKAGE_CRYPTSETUP=y
BR2_PACKAGE_DROPBEAR=y
BR2_PACKAGE_DROPBEAR_DISABLE_REVERSEDNS=y
BR2_PACKAGE_DROPBEAR_SFTPSERVER=y
BR2_PACKAGE_HOST_LINUX_HEADERS_CUSTOM_6_1=y
BR2_PACKAGE_IPROUTE2=y
BR2_PACKAGE_IPTABLES=y
BR2_PACKAGE_LINUX_FIRMWARE=y
BR2_PACKAGE_LINUX_FIRMWARE_RTL_81XX=y
BR2_PACKAGE_QEMU=y
BR2_PACKAGE_QEMU_KEYMAP=y
BR2_PACKAGE_QEMU_SYSTEM=y
BR2_PACKAGE_QEMU_SYSTEM_X86_64=y
BR2_PACKAGE_QEMU_TOOLS=y
BR2_PACKAGE_SEABIOS=y
BR2_PACKAGE_UEFI_EDK2=y
BR2_PACKAGE_WIREGUARD_TOOLS=y
BR2_PACKAGE_WIREGUARD_TOOLS_QUICK=y
BR2_REPRODUCIBLE=y
BR2_REPRODUCIBLE_DATE="2025-08-06"
BR2_ROOTFS_DEVICE_CREATION_DYNAMIC_EUDEV=y
BR2_ROOTFS_OVERLAY="custom_overlay"
BR2_TARGET_GENERIC_GETTY_PORT="tty1"
BR2_TARGET_ROOTFS_CPIO=y
BR2_TARGET_ROOTFS_INITRAMFS=y
BR2_TARGET_ROOTFS_INITRAMFS_COMPRESSION_GZIP=y
BR2_x86_64=y
BR2_x86_zen2=y
```
